## conf/machine/imdt-6490-sbc.conf
```bitbake
#@TYPE: Machine
#@NAME: IMDT QCS6490 SBC
##@DESCRIPTION: Machine configuration for IMDT QCS6490 SBC
require conf/machine/include/qcom-qcs6490.inc

# NOTE: TPM hardware is only present on rb3gen2-industrial kit
MACHINE_FEATURES += "efi m2connector pci tpm2 phone"

KERNEL_DEVICETREE ?= " \
                      qcom/qcs6490-imdt-sbc.dtb \
                      "


MACHINE_ESSENTIAL_EXTRA_RRECOMMENDS += " \
    packagegroup-rb3gen2-firmware \
    packagegroup-rb3gen2-hexagon-dsp-binaries \
    packagegroup-rb3gen2-industrial-mezzanine-firmware \
    qairt-sdk-hexagon-v68 \
    qcom-fastcv-binaries-thundercomm-rb3gen2-dsp \
    qps615-dlkm \
"

QCOM_CDT_FILE = "cdt_core_kit"
QCOM_BOOT_FILES_SUBDIR = "qcm6490"
QCOM_PARTITION_FILES_SUBDIR ?= "partitions/qcs6490-imdt-sbc/emmc"

QCOM_BOOT_FIRMWARE = "firmware-qcom-boot-qcs6490-imdt-sbc"
QCOM_CDT_FIRMWARE = "firmware-qcom-cdt-qcs6490"

# Isolate rt cpu
QCOM_RT_CPU        = "7"
QCOM_IRQAFF        = "0-6"
QCOM_RCU_NOCBS     = "7"
QCOM_RCU_EXPEDITED = "1"
QCOM_CPUIDLE_OFF   = "1"

UBOOT_CONFIG = "qcs6490-rb3gen2"
```

## conf/machine/include/imdt-common.inc
```bitbake
# Common machine file changes
MACHINE_EXTRA_RDEPENDS += "linux-firmware-cypd6125"
```
